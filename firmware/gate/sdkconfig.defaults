## firmware/gate/sdkconfig.defaults
```kconfig
# 目标：ESP32-S3-DevKitC-1 N16R8（16MB flash + 8MB 八线 PSRAM）
CONFIG_IDF_TARGET="esp32s3"

CONFIG_ESPTOOLPY_FLASHSIZE_16MB=y
CONFIG_ESPTOOLPY_FLASHMODE_QIO=y
CONFIG_ESPTOOLPY_FLASHFREQ_80M=y

CONFIG_PARTITION_TABLE_CUSTOM=y
CONFIG_PARTITION_TABLE_CUSTOM_FILENAME="partitions.csv"

# PSRAM：ESP-SR 的模型和 AFE 缓冲要用，M0 的验收标准就是它被识别到
CONFIG_SPIRAM=y
CONFIG_SPIRAM_MODE_OCT=y
CONFIG_SPIRAM_SPEED_80M=y
CONFIG_SPIRAM_USE_MALLOC=y

CONFIG_FREERTOS_HZ=1000

# 板载 USB-JTAG 直接出日志，不用外接串口
CONFIG_ESP_CONSOLE_USB_SERIAL_JTAG=y

# ---- ESP-SR（M5 语音）----------------------------------------------------
# 模型放 flash 的 model 分区（partitions.csv 里那 6MB），
# esp-sr 的 CMake 认死了分区名就叫 "model"，改名字模型就不会被烧进去。
CONFIG_MODEL_IN_FLASH=y

# 唤醒词：乐鑫现成模型（自定义唤醒词是付费商业服务，方案 §7.4）。
# 换词就改这一行 —— wakenet 那一栏是多选，勾几个就烧几个，别忘了删旧的。
CONFIG_SR_WN_WN9_NIHAOXIAOZHI_TTS=y

# 命令词：MultiNet7 中文量化版。命令表在 main/sr.c 里运行时注册，不在这里配
CONFIG_SR_MN_CN_MULTINET7_QUANT=y

# ESP-SR 对主频和 cache 有硬要求，配不够会掉帧、识别率断崖下降
CONFIG_ESP_DEFAULT_CPU_FREQ_MHZ_240=y
CONFIG_ESP32S3_INSTRUCTION_CACHE_32KB=y
CONFIG_ESP32S3_DATA_CACHE_64KB=y
CONFIG_ESP32S3_DATA_CACHE_LINE_64B=y
```

## firmware/remote/sdkconfig.defaults
```kconfig
# 目标：ESP32-C3 SuperMini（4MB flash）
CONFIG_IDF_TARGET="esp32c3"

CONFIG_ESPTOOLPY_FLASHSIZE_4MB=y
CONFIG_PARTITION_TABLE_SINGLE_APP=y

CONFIG_FREERTOS_HZ=1000

# 深睡：flash 断电，目标 <20µA
CONFIG_ESP_SLEEP_POWER_DOWN_FLASH=y

# 板载 USB-JTAG 出日志。⚠ 烧录前先把拨动开关拨到关（防 5V 倒灌进电池）
CONFIG_ESP_CONSOLE_USB_SERIAL_JTAG=y
```
